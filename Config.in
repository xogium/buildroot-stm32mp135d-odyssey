## configs/stm32mp135d_odyssey_defconfig
```kconfig
BR2_arm=y
BR2_cortex_a7=y
BR2_TOOLCHAIN_BUILDROOT_UCLIBC=y
BR2_TOOLCHAIN_BUILDROOT_WCHAR=y
BR2_TOOLCHAIN_BUILDROOT_CXX=y
BR2_TARGET_GENERIC_GETTY_PORT="ttySTM0"
BR2_ROOTFS_OVERLAY="$(BR2_EXTERNAL_STM32MP135D_ODYSSEY_PATH)/rootfs_overlay"
BR2_ROOTFS_POST_BUILD_SCRIPT="$(BR2_EXTERNAL_STM32MP135D_ODYSSEY_PATH)/board/stm32mp135d-odyssey/scripts/rootfs_postbuild.sh"
BR2_ROOTFS_POST_IMAGE_SCRIPT="support/scripts/genimage.sh"
BR2_ROOTFS_POST_SCRIPT_ARGS="-c $(BR2_EXTERNAL_STM32MP135D_ODYSSEY_PATH)/board/stm32mp135d-odyssey/utilities/genimage.cfg"
BR2_LINUX_KERNEL=y
BR2_LINUX_KERNEL_CUSTOM_GIT=y
BR2_LINUX_KERNEL_CUSTOM_REPO_URL="https://github.com/xogium/st-linux"
BR2_LINUX_KERNEL_CUSTOM_REPO_VERSION="v6.1-stm32mp-odyssey-r4"
BR2_LINUX_KERNEL_USE_CUSTOM_CONFIG=y
BR2_LINUX_KERNEL_CUSTOM_CONFIG_FILE="$(BR2_EXTERNAL_STM32MP135D_ODYSSEY_PATH)/board/stm32mp135d-odyssey/configs/linux.config"
BR2_LINUX_KERNEL_ZSTD=y
BR2_LINUX_KERNEL_DTS_SUPPORT=y
BR2_LINUX_KERNEL_CUSTOM_DTS_PATH="$(BR2_EXTERNAL_STM32MP135D_ODYSSEY_PATH)/board/stm32mp135d-odyssey/dts/stm32mp135d-odyssey-grove.dts"
BR2_LINUX_KERNEL_INSTALL_TARGET=y
BR2_PACKAGE_BUSYBOX_WATCHDOG=y
BR2_PACKAGE_BUSYBOX_WATCHDOG_PERIOD="10"
BR2_PACKAGE_PYTHON3=y
BR2_PACKAGE_PYTHON3_BZIP2=y
BR2_PACKAGE_PYTHON3_CURSES=y
BR2_PACKAGE_PYTHON3_DECIMAL=y
BR2_PACKAGE_PYTHON3_READLINE=y
BR2_PACKAGE_PYTHON3_SSL=y
BR2_PACKAGE_PYTHON3_SQLITE=y
BR2_PACKAGE_PYTHON3_PYEXPAT=y
BR2_PACKAGE_PYTHON3_XZ=y
BR2_PACKAGE_PYTHON3_ZLIB=y
BR2_TARGET_ROOTFS_EXT2=y
BR2_TARGET_ROOTFS_EXT2_4=y
BR2_TARGET_ROOTFS_EXT2_SIZE="100M"
BR2_TARGET_ARM_TRUSTED_FIRMWARE=y
BR2_TARGET_ARM_TRUSTED_FIRMWARE_CUSTOM_GIT=y
BR2_TARGET_ARM_TRUSTED_FIRMWARE_CUSTOM_REPO_URL="https://git.xogium.me/git/xogium/st-arm-trusted-firmware.git"
BR2_TARGET_ARM_TRUSTED_FIRMWARE_CUSTOM_REPO_VERSION="v2.8-stm32mp-odyssey-r1"
BR2_TARGET_ARM_TRUSTED_FIRMWARE_PLATFORM="stm32mp1"
BR2_TARGET_ARM_TRUSTED_FIRMWARE_FIP=y
BR2_TARGET_ARM_TRUSTED_FIRMWARE_BL32_OPTEE=y
BR2_TARGET_ARM_TRUSTED_FIRMWARE_UBOOT_AS_BL33=y
BR2_TARGET_ARM_TRUSTED_FIRMWARE_UBOOT_BL33_IMAGE="u-boot-nodtb.bin"
BR2_TARGET_ARM_TRUSTED_FIRMWARE_ADDITIONAL_VARIABLES="STM32MP_EMMC=1 STM32MP_EMMC_BOOT=1 STM32MP_SDMMC=1 AARCH32_SP=optee DTB_FILE_NAME=stm32mp135d-odyssey.dtb BL33_CFG=$(BINARIES_DIR)/u-boot.dtb STM32MP_USB_PROGRAMMER=1"
BR2_TARGET_ARM_TRUSTED_FIRMWARE_IMAGES="fip.bin *.stm32"
BR2_TARGET_ARM_TRUSTED_FIRMWARE_NEEDS_DTC=y
BR2_TARGET_OPTEE_OS=y
BR2_TARGET_OPTEE_OS_CUSTOM_GIT=y
BR2_TARGET_OPTEE_OS_CUSTOM_REPO_URL="https://git.xogium.me/git/xogium/st-optee_os.git"
BR2_TARGET_OPTEE_OS_CUSTOM_REPO_VERSION="3.19.0-stm32mp-odyssey-r2"
BR2_TARGET_OPTEE_OS_NEEDS_DTC=y
BR2_TARGET_OPTEE_OS_NEEDS_PYTHON_CRYPTOGRAPHY=y
BR2_TARGET_OPTEE_OS_PLATFORM="stm32mp1"
BR2_TARGET_OPTEE_OS_PLATFORM_FLAVOR="135D_ODYSSEY"
BR2_TARGET_OPTEE_OS_ADDITIONAL_VARIABLES="CFG_WITH_TUI=n CFG_TEE_CORE_LOG_LEVEL=2"
BR2_TARGET_UBOOT=y
BR2_TARGET_UBOOT_BUILD_SYSTEM_KCONFIG=y
BR2_TARGET_UBOOT_CUSTOM_GIT=y
BR2_TARGET_UBOOT_CUSTOM_REPO_URL="https://git.xogium.me/git/xogium/st-u-boot.git"
BR2_TARGET_UBOOT_CUSTOM_REPO_VERSION="v2022.10-stm32mp-odyssey-r2"
BR2_TARGET_UBOOT_BOARD_DEFCONFIG="stm32mp13"
BR2_TARGET_UBOOT_NEEDS_PYLIBFDT=y
# BR2_TARGET_UBOOT_FORMAT_BIN is not set
BR2_TARGET_UBOOT_FORMAT_DTB=y
BR2_TARGET_UBOOT_FORMAT_CUSTOM=y
BR2_TARGET_UBOOT_FORMAT_CUSTOM_NAME="u-boot-nodtb.bin"
BR2_TARGET_UBOOT_CUSTOM_MAKEOPTS="DEVICE_TREE=stm32mp135d-odyssey"
BR2_PACKAGE_HOST_GENIMAGE=y
BR2_PACKAGE_HOST_UBOOT_TOOLS=y
BR2_PACKAGE_HOST_UBOOT_TOOLS_BOOT_SCRIPT=y
BR2_PACKAGE_HOST_UBOOT_TOOLS_BOOT_SCRIPT_SOURCE="$(BR2_EXTERNAL_STM32MP135D_ODYSSEY_PATH)/board/stm32mp135d-odyssey/utilities/boot.cmd"
BR2_PACKAGE_MRAA_GROVE=y
BR2_PACKAGE_PYTHON_GROVEPY=y
```

## packages/Config.in
```kconfig
menu "Target packages"

source "$BR2_EXTERNAL_STM32MP135D_ODYSSEY_PATH/packages/bmi08x-src/Config.in"
source "$BR2_EXTERNAL_STM32MP135D_ODYSSEY_PATH/packages/libbma456/Config.in"
source "$BR2_EXTERNAL_STM32MP135D_ODYSSEY_PATH/packages/libbmi088/Config.in"
source "$BR2_EXTERNAL_STM32MP135D_ODYSSEY_PATH/packages/mraa-grove/Config.in"
source "$BR2_EXTERNAL_STM32MP135D_ODYSSEY_PATH/packages/python-grovepy/Config.in"
source "$BR2_EXTERNAL_STM32MP135D_ODYSSEY_PATH/packages/python-smbus2/Config.in"

endmenu
```

## packages/bmi08x-src/Config.in
```kconfig
config BR2_PACKAGE_BMI08X_SRC
	bool
	help
	  Bosch's BMI08x Sensor API source code.
	  Enable this to building bmi088-python.
```

## packages/libbma456/Config.in
```kconfig
config BR2_PACKAGE_LIBBMA456
	bool "libbma456"
	help
	  Seeed's BMA456 library, for use with grove.py.
```

## packages/libbmi088/Config.in
```kconfig
config BR2_PACKAGE_LIBBMI088
	select BR2_PACKAGE_BMI08X_SRC
	bool "libbmi088"
	help
	  bmi088-python, for use with grove.py.
```

## packages/python-bme680/Config.in
```kconfig
config BR2_PACKAGE_PYTHON_BME680
	bool "python-bme680"
	help
	  Python library for the BME680 temperature, humidity and gas sensor

	  https://github.com/pimoroni/bme680-python
```

## packages/python-grovepy/Config.in
```kconfig
config BR2_PACKAGE_PYTHON_GROVEPY
	bool "python-grovepy"
	select BR2_PACKAGE_PYTHON_SMBUS2 # runtime
	help
	  Python library for Seeedstudio Grove devices.

	  https://github.com/seeed-studio/grove.py
```
